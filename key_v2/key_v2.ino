#include <avr/sleep.h>
#include <avr/pgmspace.h>

// ATtiny85 Default Pin Names
// PB0 - Physical pin 5
// PB1 - Physical pin 6 (LED_BUILTIN)
// PB2 - Physical pin 7 (INT0)
// PB3 - Physical pin 2
// PB4 - Physical pin 3 
// PB5 - Physical pin 1 (RESET, avoid using unless fuse-modified)

// Functional Pin Assignments
#define TX_PIN PB3              // 433MHz Transmitter Data Pin
#define STATUS_LED PB2          // Onboard LED for Transmission Indication
#define SIGNAL_SELECTOR_SWITCH PB0        // Emits signal 1 if this pin is LOW, or signal 2 if this pin is HIGH

// Signal Data (Stored in Flash to save RAM)
const int16_t signal_data_1[] PROGMEM = {41422,-16642,231,-132,2615,-98,227,-228,227,-66,4181,-14770,97,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463,-132};
const int16_t signal_data_2[] PROGMEM = {1642,-490,97,-890,65,-632,97,-526,229,-100,1283,-166,699,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3355,-5386};

const int16_t* selected_signal;
uint16_t signal_length;
uint16_t pointer = 0;

void setup() {
    // Configure Pins
    pinMode(TX_PIN, OUTPUT);
    pinMode(STATUS_LED, OUTPUT);
    pinMode(SIGNAL_SELECTOR_SWITCH, INPUT_PULLUP);

    // Ensure TX & Antenna are Off
    digitalWrite(TX_PIN, HIGH);
    digitalWrite(STATUS_LED, HIGH);

    delay(10); // Give enough time for the tx to power on

    if (digitalRead(SIGNAL_SELECTOR_SWITCH) == LOW) {
        selected_signal = signal_data_1;
        signal_length = sizeof(signal_data_1) / sizeof(signal_data_1[0]);

        blink(50, 1);
        delay(200);
    } else {
        selected_signal = signal_data_2;
        signal_length = sizeof(signal_data_2) / sizeof(signal_data_2[0]);

        blink(50, 2);
        delay(200);
    }

    digitalWrite(STATUS_LED, LOW);
}

void blink(int interval, int times) {
    for (int i = 0; i < times; i++) {
        digitalWrite(STATUS_LED, HIGH);
        delay(interval);
        digitalWrite(STATUS_LED, LOW);
        delay(interval);
    }
}

bool terminated = false;
uint8_t loop_count = 0;

void loop() {
    if(terminated) {
        return;
    }

    // Transmit the signal with LED indication
    int16_t val = pgm_read_word_near(selected_signal + pointer);

    if (val > 0) {
        digitalWrite(TX_PIN, HIGH);
        digitalWrite(STATUS_LED, HIGH);
    } else {
        digitalWrite(TX_PIN, LOW);
        digitalWrite(STATUS_LED, LOW);
    }

    // First run uses smartDelay, second run uses smarterDelay
    if (loop_count == 0) {
        smartDelay(abs(val));
    } else {
        smarterDelay(abs(val));
    }

    if (++pointer >= signal_length) {
        pointer = 0;  // Reset pointer when end of signal is reached
        digitalWrite(TX_PIN, LOW);
        digitalWrite(STATUS_LED, LOW);
        
        loop_count++;
        if (loop_count == 1) {
            // Pause for 500ms before starting the second loop
            delay(500);
        }
        if (loop_count >= 2) {
            terminated = true;
        }
    }
}

// Function to handle both short and long delays
void smartDelay(uint16_t us) {
    if (us > 16000) {
        delay(us / 1000);  // Convert to milliseconds for longer delays
    } else {
        delayMicroseconds(us);
    }
}

void smarterDelay(int16_t us) {
    if (us > 10000) {
        int16_t ms = us / 1000;
        delay(ms);
        us %= 1000;  // Cleaner remainder calculation
    }
    
    if (us > 0) {  // Only do micros loop if needed
        uint32_t start = micros();
        while (micros() - start < us);
    }
}