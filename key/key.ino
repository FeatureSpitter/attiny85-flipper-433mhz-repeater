#include <avr/sleep.h>
#include <avr/pgmspace.h>

// ATtiny85 Default Pin Names
// PB0 - Physical pin 5
// PB1 - Physical pin 6 (LED_BUILTIN)
// PB2 - Physical pin 7 (INT0)
// PB3 - Physical pin 2
// PB4 - Physical pin 3 
// PB5 - Physical pin 1 (RESET, avoid using unless fuse-modified)

// Functional Pin Assignments
#define TX_PIN PB3              // 433MHz Transmitter Data Pin
#define STATUS_LED PB4          // Onboard LED for Transmission Indication
#define SIGNAL_1_BTN PB2        // Emits signal 1 if this pin is LOW
#define SIGNAL_2_BTN PB1        // Emits signal 2 if this pin is LOW
#define SIGNAL_3_BTN PB0        // Emits signal 3 if this pin is LOW

// Signal Data (Stored in Flash to save RAM)
const int16_t signal_data_1[] PROGMEM = {4125,-9928,129,-922,65,-954,197,-98,795,-266,65,-66,131,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4113,-7473};
const int16_t signal_data_2[] PROGMEM = {1642,-490,97,-890,65,-632,97,-526,229,-100,1283,-166,699,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3355,-5386};
const int16_t signal_data_3[] PROGMEM = {1614,-14340,65,-2518,97,-66,367,-132,195,-130,659,-98,3021,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845,-12302};

const int16_t* selected_signal;
uint16_t signal_length;
uint16_t pointer = 0;

void setup() {
    // Configure Pins
    pinMode(TX_PIN, OUTPUT);
    pinMode(STATUS_LED, OUTPUT);
    pinMode(SIGNAL_1_BTN, INPUT_PULLUP);
    pinMode(SIGNAL_2_BTN, INPUT_PULLUP);
    pinMode(SIGNAL_3_BTN, INPUT_PULLUP);

    // Ensure TX & Antenna are Off
    digitalWrite(TX_PIN, LOW);
    digitalWrite(STATUS_LED, HIGH);

    delay(10); // Give enough time for the tx to power on

    bool signal_selected = false;

    while (!signal_selected) {
        if (digitalRead(SIGNAL_1_BTN) == LOW) {
            selected_signal = signal_data_1;
            signal_length = sizeof(signal_data_1) / sizeof(signal_data_1[0]);

            blink(200, 1);

            signal_selected = true;
        } else if (digitalRead(SIGNAL_2_BTN) == LOW) {
            selected_signal = signal_data_2;
            signal_length = sizeof(signal_data_2) / sizeof(signal_data_2[0]);

            blink(200, 2);

            signal_selected = true;
        } else if (digitalRead(SIGNAL_3_BTN) == LOW) {
            selected_signal = signal_data_3;
            signal_length = sizeof(signal_data_3) / sizeof(signal_data_3[0]);

            blink(200, 3);

            signal_selected = true;
        }
    }

    digitalWrite(STATUS_LED, LOW);
}

void blink(int interval, int times) {
    for (int i = 0; i < times; i++) {
        digitalWrite(STATUS_LED, HIGH);
        delay(interval);
        digitalWrite(STATUS_LED, LOW);
        delay(interval);
    }
}

void loop() {
    // Transmit the signal with LED indication
      int16_t val = pgm_read_word_near(selected_signal + pointer);

      if (++pointer >= signal_length) {
        pointer = 0;  // Reset pointer when end of signal is reached
        digitalWrite(STATUS_LED, LOW);
        delay(3000);
      }

      if (val > 0) {
          digitalWrite(TX_PIN, HIGH);
          digitalWrite(STATUS_LED, HIGH);
      } else {
          digitalWrite(TX_PIN, LOW);
          digitalWrite(STATUS_LED, LOW);
      }

      smartDelay(abs(val));  // Handle long delays properly
}

// Function to handle both short and long delays
void smartDelay(uint16_t us) {
    if (us > 16000) {
        delay(us / 1000);  // Convert to milliseconds for longer delays
    } else {
        delayMicroseconds(us);
    }
}
